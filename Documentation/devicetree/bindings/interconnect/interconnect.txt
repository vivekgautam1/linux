## Documentation/devicetree/bindings/interconnect/interconnect.txt
```
Interconnect Provider Device Tree Bindings
=========================================

The purpose of this document is to define a common set of generic interconnect
providers/consumers properties.


= interconnect providers =

The interconnect provider binding is intended to represent the interconnect
controllers in the system. Each provider registers a set of interconnect
nodes, which expose the interconnect related capabilities of the interconnect
to consumer drivers. These capabilities can be throughput, latency, priority
etc. The consumer drivers set constraints on interconnect path (or endpoints)
depending on the use case. Interconnect providers can also be interconnect
consumers, such as in the case where two network-on-chip fabrics interface
directly

Required properties:
- compatible : contains the interconnect provider compatible string


= interconnect consumers =

The interconnect consumers are device nodes which consume the interconnect
path(s) provided by the interconnect provider. There can be multiple
interconnect providers on a SoC and the consumer may consume multiple paths
from different providers depending on use case and the components it has to
interact with.

Required properties:
interconnects : Pairs of phandles and interconnect provider specifier to denote
	        the edge source and destination ports of the interconnect path.

Optional properties:
interconnect-names : List of interconnect path name strings sorted in the same
		     order as the interconnects property. Consumers drivers will use
		     interconnect-names to match interconnect paths with interconnect
		     specifiers.

Example:

	sdhci@7864000 {
		...
		interconnects = <&pnoc 78 &bimc 512>;
		interconnect-names = "ddr";
	};
```

## Documentation/devicetree/bindings/phy/qcom-qmp-phy.txt
```
Qualcomm QMP PHY
----------------

Required properties:
 - compatible: compatible list, contains "qcom,qmp-14nm-phy".
 - reg: offset and length of the PHY register set.
 - #phy-cells: must be 2.
    - Cell after phy phandle is device type from:
	- PHY_TYPE_PCIE
	- PHY_TYPE_UFS
	- PHY_TYPE_USB3
    - Second cell should be the port (lane) number.
 - clocks: a list of phandles and clock-specifier pairs,
	   one for each entry in clock-names.
 - clock-names: must be "cfg_ahb" for phy config clock,
			"aux" for phy aux clock,
			"ref_clk" for 19.2 MHz ref clk,
			"ref_clk_src" reference clock source,
			"pipe" pipe clock (Optional).
 - resets: a list of phandles and reset controller specifier pairs,
	   one for each entry in reset-names.
 - reset-names: must be	"phy" for reset of phy block,
			"common" for phy common reset,
			"cfg" for phy's ahb cfg reset (Optional).
 - vdda-phy-supply: Phandle to a regulator supply to PHY core block.
 - vdda-pll-supply: Phandle to 1.8V regulator supply to PHY refclk pll block.

Optional properties:
 - vddp-ref-clk-supply: Phandle to a regulator supply to any specific reflclk
			pll block.

Required nodes:
 Each device node of QMP phy is required to have as many child nodes as
 the number of ports (lanes) PHY has.

Required properties (port/child node):
 - tx-offset: offset to port's Tx register address space.
 - rx-offset: offset to port's Rx register address space.
 - pcs-offset: offset to port's PCS register address space.

Optional properties (port/child node):
 - resets: a list of phandles and reset controller specifier pairs,
	   one for each entry in reset-names.
 - reset-names: "lane<port-number>" for reset specific to
		each port (lane).

Example:
	pcie_phy: pciephy@34000 {
		compatible = "qcom,qmp-14nm-phy";
		reg = <0x034000 0x3fff>;
		#address-cells = <1>;
		#size-cells = <0>;
		#phy-cells = <2>;

		clocks = <&gcc GCC_PCIE_PHY_AUX_CLK>,
			<&gcc GCC_PCIE_PHY_CFG_AHB_CLK>;
		clock-names = "aux", "cfg_ahb";

		vdda-phy-supply = <&pm8994_l28>;
		vdda-pll-supply = <&pm8994_l12>;

		resets = <&gcc GCC_PCIE_PHY_BCR>,
			<&gcc GCC_PCIE_PHY_COM_BCR>,
			<&gcc GCC_PCIE_PHY_COM_NOCSR_BCR>;
		reset-names = "phy", "common", "cfg";

		port@0 {
			reg = <0>;
			tx-offset = <0x1000>;
			rx-offset = <0x1200>;
			pcs-offset = <0x1400>;
			resets = <&gcc GCC_PCIE_0_PHY_BCR>;
			reset-names = "lane0";
		};
		...
	};
```

## Documentation/devicetree/bindings/regulator/qcom-labibb-regulator.txt
```
Qualcomm's LAB(LCD AMOLED BOOST)/IBB(Inverting Buck-Boost) Regulator

LAB can be used as a standalone positive boost power supply for general purpose
applications. IBB can be used as a standalone negative power supply for general
applications. Also, LAB and IBB can be used together to provide power supply for
display panels.

Main node required properties:

- compatible:			Must be "qcom,lab-ibb-regulator"
- #address-cells:		Must be 1
- #size-cells:			Must be 0

LAB subnode required properties:

- reg:				Specifies the SPMI address.
- reg-names:			Register names. Must be "lab".
- regulator-name:		A string used to describe the regulator.
- interrupts:			Specify the interrupts as per the interrupt
				encoding.
- interrupt-names:		Interrupt names to match up 1-to-1 with
				the interrupts specified in 'interrupts'
				property.

IBB subnode required properties:

- reg:				Specifies the SPMI address.
- reg-names:			Register names. Must be "ibb".
- regulator-name:		A string used to describe the regulator.
- interrupts:			Specify the interrupts as per the interrupt
				encoding.
- interrupt-names:		Interrupt names to match up 1-to-1 with
				the interrupts specified in 'interrupts'
				property.
- qcom,ibb-lab-pwrup-delay:	Power up delay (in us) for IBB regulator when
				it is enabled or turned on. Supported values
				are 1000, 2000, 4000 and 8000.

Example:
	pmi8998_lsid1: pmic@3 {
		qcom-labibb-regulator {
			compatible = "qcom,lab-ibb-regulator";
			#address-cells = <1>;
			#size-cells = <0>;

			lab_regulator: qcom,lab@de00 {
				reg = <0xde00>;
				reg-names = "lab";
				regulator-name = "lab_reg";

				interrupts = <0x3 0xde 0x0 IRQ_TYPE_EDGE_RISING>;
				interrupt-names = "lab-sc-err";
			};

			ibb_regulator: qcom,ibb@dc00 {
				reg = <0xdc00>;
				reg-names = "ibb";
				regulator-name = "ibb_reg";

				interrupts = <0x3 0xdc 0x2 IRQ_TYPE_EDGE_RISING>;
				interrupt-names = "ibb-sc-err";
				qcom,ibb-lab-pwrup-delay = <8000>;
			};

		};
	};
```
